## conf/layer.conf
```bitbake
# We have a conf and classes directory, add to BBPATH
BBPATH .= ":${LAYERDIR}"

# We have recipes-* directories, add to BBFILES
BBFILES += "${LAYERDIR}/recipes-*/*/*.bb \
            ${LAYERDIR}/recipes-*/*/*.bbappend"

BBFILE_COLLECTIONS += "meta-pi-practice"
BBFILE_PATTERN_meta-pi-practice = "^${LAYERDIR}/"
BBFILE_PRIORITY_meta-pi-practice = "6"

LAYERDEPENDS_meta-pi-practice = "core"
LAYERSERIES_COMPAT_meta-pi-practice = "dunfell"
```
